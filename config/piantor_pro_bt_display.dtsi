// ============================================================================
// CUSTOM DISPLAY WIDGETS - Battery Percentage Display
// File: piantor_pro_bt_display.dtsi
// ============================================================================

#ifdef CONFIG_ZMK_DISPLAY

#include <zephyr/kernel.h>
#include <zephyr/device.h>
#include <zephyr/devicetree.h>
#include <zephyr/drivers/display.h>
#include <lvgl.h>

// ZMK Battery includes
#include <zmk/battery.h>
#include <zmk/display/widgets/battery_status.h>
#include <zmk/events/battery_state_changed.h>
#include <zmk/usb.h>
#include <zmk/ble.h>
#include <zmk/events/usb_conn_state_changed.h>

// Custom battery widget structure
struct battery_status_state {
    uint8_t level;
#if IS_ENABLED(CONFIG_USB_DEVICE_STACK)
    bool usb_present;
#endif
};

// Initialize battery state
static struct battery_status_state get_battery_state(const zmk_event_t *_eh) {
    return (struct battery_status_state) {
        .level = zmk_battery_state_of_charge(),
#if IS_ENABLED(CONFIG_USB_DEVICE_STACK)
        .usb_present = zmk_usb_is_powered(),
#endif
    };
}

// Update battery display with percentage
static void set_battery_status(lv_obj_t *label, struct battery_status_state state) {
    char text[16] = {};

#if IS_ENABLED(CONFIG_USB_DEVICE_STACK)
    if (state.usb_present) {
        snprintf(text, sizeof(text), "BAT %3u%% CHG", state.level);
    } else {
#endif
        snprintf(text, sizeof(text), "BAT %3u%%", state.level);
#if IS_ENABLED(CONFIG_USB_DEVICE_STACK)
    }
#endif

    lv_label_set_text(label, text);
}

// Event listener for battery changes
static void battery_status_update_cb(struct battery_status_state state) {
    struct zmk_widget_battery_status *widget;
    SYS_SLIST_FOR_EACH_CONTAINER(&zmk_widget_battery_status_list, widget, node) {
        set_battery_status(widget->obj, state);
    }
}

// Battery state changed event handler
static int battery_status_listener(const zmk_event_t *eh) {
    battery_status_update_cb(get_battery_state(eh));
    return ZMK_EV_EVENT_BUBBLE;
}

ZMK_LISTENER(widget_battery_status, battery_status_listener);
ZMK_SUBSCRIPTION(widget_battery_status, zmk_battery_state_changed);

#if IS_ENABLED(CONFIG_USB_DEVICE_STACK)
ZMK_SUBSCRIPTION(widget_battery_status, zmk_usb_conn_state_changed);
#endif

// Initialize battery widget
int zmk_widget_battery_status_init(struct zmk_widget_battery_status *widget, lv_obj_t *parent) {
    widget->obj = lv_label_create(parent);

    lv_obj_set_style_text_font(widget->obj, &lv_font_montserrat_16, LV_PART_MAIN);
    lv_obj_set_style_text_align(widget->obj, LV_TEXT_ALIGN_RIGHT, LV_PART_MAIN);
    lv_label_set_text(widget->obj, "BAT ---");

    sys_slist_append(&zmk_widget_battery_status_list, &widget->node);

    battery_status_update_cb(get_battery_state(NULL));

    return 0;
}

lv_obj_t *zmk_widget_battery_status_obj(struct zmk_widget_battery_status *widget) {
    return widget->obj;
}

#endif // CONFIG_ZMK_DISPLAY
